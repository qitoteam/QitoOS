/*
 * QitoOS - kernel link script
 *
 * The kernel is a higher-half image: it is loaded at physical 0x100000 by the
 * bootloader but linked to run at 0xFFFFFFFF80100000. The bootloader maps both
 * views before jumping here, so no early relocation trampoline is needed.
 */

OUTPUT_FORMAT(elf64-x86-64)
OUTPUT_ARCH(i386:x86-64)
ENTRY(_kernel_entry)

KERNEL_PHYS_BASE = 0x100000;
KERNEL_VIRT_BASE = 0xFFFFFFFF80000000;

SECTIONS
{
    . = KERNEL_VIRT_BASE + KERNEL_PHYS_BASE;
    __kernel_start = .;

    .text ALIGN(4K) : AT(ADDR(.text) - KERNEL_VIRT_BASE)
    {
        __text_start = .;
        *(.text.entry)
        *(.text .text.*)
        __text_end = .;
    }

    .rodata ALIGN(4K) : AT(ADDR(.rodata) - KERNEL_VIRT_BASE)
    {
        __rodata_start = .;
        *(.rodata .rodata.*)

        /* Registries built by the linker: drivers and syscall tables can
         * register themselves without a central list. */
        . = ALIGN(8);
        __drivers_start = .;
        KEEP(*(.qito_drivers))
        __drivers_end = .;

        . = ALIGN(8);
        __initcalls_start = .;
        KEEP(*(.qito_initcalls))
        __initcalls_end = .;

        /* The symbol table, generated by tools/gensyms.py on a second pass,
         * so panics can name functions rather than printing addresses. */
        . = ALIGN(8);
        __ksym_start = .;
        KEEP(*(.ksyms))
        __ksym_end = .;

        __rodata_end = .;
    }

    .data ALIGN(4K) : AT(ADDR(.data) - KERNEL_VIRT_BASE)
    {
        __data_start = .;
        *(.data .data.*)
        __data_end = .;
    }

    .bss ALIGN(4K) : AT(ADDR(.bss) - KERNEL_VIRT_BASE)
    {
        __bss_start = .;
        *(COMMON)
        *(.bss .bss.*)
        . = ALIGN(8);
        __bss_end = .;
    }

    . = ALIGN(4K);
    __kernel_end = .;

    __kernel_phys_start = __kernel_start - KERNEL_VIRT_BASE;
    __kernel_phys_end   = __kernel_end - KERNEL_VIRT_BASE;

    /DISCARD/ :
    {
        *(.eh_frame*)
        *(.note*)
        *(.comment)
        *(.interp)
    }
}
